## boards/arm/wio_wm1110/Kconfig.board
```kconfig
# Copyright (c) 2023 Joel Guittet
# Wio Terminal board configuration

# SPDX-License-Identifier: Apache-2.0

config BOARD_WIO_WM1110
	bool "Wio WM1110"
```

## boards/arm/wio_wm1110/Kconfig.defconfig
```kconfig
# Copyright (c) 2024 Phil Erwin
# Wio Wm1110 Board Configuration

# SPDX-License-Identifier: Apache-2.0

config BOARD
	default "wio_wm1110"
	depends on BOARD_WIO_WM1110
```

## boards/arm/wio_wm1110/board.yml
```yaml
board:
  name: wio_wm1110
  full_name: Wio Wm1110
  vendor: seeed
  socs:
  # Physical nRF52840 SoC on PCA10056
  - name: nrf52840
```

## boards/arm/wio_wm1110/wio_wm1110_defconfig
```kconfig
# Copyright (c) 2023 Joel Guittet
# SPDX-License-Identifier: Apache-2.0

CONFIG_BOARD_WIO_WM1110=y

CONFIG_SOC_SERIES_NRF52X=y
CONFIG_SOC_NRF52840_QIAA=y

CONFIG_ARM_MPU=y

CONFIG_GPIO=y

CONFIG_SERIAL=y
CONFIG_CONSOLE=y
CONFIG_UART_CONSOLE=y
CONFIG_UART_NRFX=y

CONFIG_CONSOLE_SUBSYS=y
CONFIG_CONSOLE_GETCHAR=y
CONFIG_CONSOLE_GETCHAR_BUFSIZE=16
CONFIG_CONSOLE_PUTCHAR_BUFSIZE=16

CONFIG_LORA=y
CONFIG_LORA_LR1110=y

CONFIG_SENSOR=y
CONFIG_LIS2DH=y

#-------------------

# CONFIG_CORTEX_M_SYSTICK=y
# CONFIG_HW_STACK_PROTECTION=y
# CONFIG_REGULATOR=y

# BOSSA bootloader
# CONFIG_BOOTLOADER_BOSSA=y
# CONFIG_BOOTLOADER_BOSSA_ADAFRUIT_UF2=y
# CONFIG_BUILD_OUTPUT_UF2=y

# Console over USB CDC-ACM
# CONFIG_UART_INTERRUPT_DRIVEN=y
# CONFIG_USB_DEVICE_STACK=y
# CONFIG_USB_DEVICE_INITIALIZE_AT_BOOT=y
# CONFIG_USB_DEVICE_VID=0x2886
# CONFIG_USB_DEVICE_PID=0x802D
# CONFIG_USB_DEVICE_MANUFACTURER="Seeed Studio"
# CONFIG_USB_DEVICE_PRODUCT="Wio Terminal"
# CONFIG_USB_CDC_ACM_LOG_LEVEL_OFF=y
```

## drivers/lora/Kconfig.lr1110
```kconfig
#
# Copyright (c) 2019 Manivannan Sadhasivam
#
# SPDX-License-Identifier: Apache-2.0
#

menuconfig LORA_LR1110
	bool "Semtech LR-series driver"
	select HAS_SEMTECH_RADIO_DRIVERS
	depends on SPI
	help
	  Enable LoRa driver for Semtech LR1110.
```

## drivers/trace/Kconfig
```kconfig
# Kconfig - Misc network drivers configuration options
# SPDX-License-Identifier: Apache-2.0

config LXK_TRACE
	bool "Jake Trace Driver"
	help
	  Driver for Jake Trace tool

config LXK_TRACE_SWAPS
	bool "Trace process swaps"
	help
	  Driver for Jake Trace tool
	select THREAD_NAME

config LXK_TRACE_UART
	bool "Trace emitted on UART pin"
	help
	  Trace data emitted on UART pin
```

## dts/bindings/lora/semtech,lr1110.yaml
```yaml
# Copyright (c) 2020 Andreas Sandberg
# Copyright (c) 2024 Phil Erwin
#
# SPDX-License-Identifier: Apache-2.0

description: Semtech LR1110 LoRa Modem

compatible: "semtech,lr1110"

include: semtech,lr1110-base.yaml

properties:
    reset-gpios:
      required: true
    busy-gpios:
      required: true
    dio9-gpios:
      required: true
```
